## arch/arm64/hotplug/Kconfig
```kconfig
config HIMA_HOTPLUG
        bool "Enable hima-hotplug cpu hotplug driver"
	depends on STATE_NOTIFIER
        default n
        help
          Generic cpu hotplugging driver for ARM SOCs

config BRICKED_HOTPLUG
	   bool "Enable kernel based mpdecision"
	   depends on MSM_RUN_QUEUE_STATS
	   default y
	   help
		 This enables kernel based multi core control.

config INTELLI_PLUG
	    bool "Enable intelli-plug cpu hotplug driver"
	    default n
	    help
	         Generic Intelli-plug cpu hotplug driver for ARM SOCs

config ALUCARD_HOTPLUG
	bool "Enable alucard-hotplug cpu hotplug driver"
	default y
	help
	Generic Alucard-hotplug cpu hotplug driver for ARM SOCs
```
